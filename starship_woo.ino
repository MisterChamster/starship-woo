/**************************************************************************
  Screen coordinates
  0 - 31-32 - 63
  -
  63
  64
  -
  127


  display.drawLine(display.width() / 2, 1, display.width() / 2, display.height(), 1);
**************************************************************************/

#include <SPI.h>
#include <Wire.h>
#include <Adafruit_GFX.h>
#include <Adafruit_SSD1306.h>
#include <Keypad.h>


Adafruit_SSD1306 display(128, 64, &Wire, -1);

const int8_t STARSHIP_LEN = 16;
const int8_t BOSS_LEN     = 32;

int8_t STARSHIP_HEALTH = 5;
int8_t BOSS_HEALTH     = 50;
int8_t goodpews[30][2];
int8_t evilpews[30][2];

const uint8_t STARSHIP_Y = 111;
uint8_t       STARSHIP_X = 24;
uint8_t       BOSS_Y     = 0;
uint8_t       BOSS_X     = 16;

//bool   bosscolour = 1;
int8_t   bossphase  = 0;
uint16_t phasestage = 0;
uint8_t  bossrand; 
bool     leftright;

char keys[4][4] = 
{
  {'1','2','3','A'},
  {'4','5','6','B'},
  {'7','8','9','C'},
  {'*','0','#','D'}
};

const int8_t pin_rows[4]   = {5, 4, 3, 2}; 
const int8_t pin_column[4] = {9, 8, 7, 6}; 
Keypad keypad = Keypad(makeKeymap(keys), pin_rows, pin_column, 4, 4);

static const unsigned char FUX55[] PROGMEM =
{ 0b00000001, 0b10000000,
  0b00000001, 0b10000000,
  0b01100001, 0b10000110,
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  0b00000000, 0b00000000 };

static const unsigned char ONA35[] PROGMEM =
{ 0b00000001, 0b10000000,
  0b00000001, 0b10000000,
  0b00000001, 0b10000000,
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  0b00000000, 0b00000000 };

static const unsigned char ANS17[] PROGMEM =
{ 0b00000001, 0b10000000,
  0b00000001, 0b10000000,
  0b00001001, 0b10010000,
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  0b00000000, 0b00000000 };

static const unsigned char MOLE9[] PROGMEM = 
{ 0b11111000, 0b10001100, 0b00110001, 0b00011111,
  0b00001000, 0b10101100, 0b00110101, 0b00010000,
  0b11101100, 0b10101100, 0b00110101, 0b00110111,
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  0b00000000, 0b00000001, 0b10000000, 0b00000000 };

static const unsigned char win_screen[] PROGMEM = 
{ 0b00000000, 0b00000000, 0b00000000, 0b00000000, 0b00000000, 0b00000000, 0b00000000, 0b00000000,
  0b00000000, 0b00000000, 0b00000000, 0b00000000, 0b00000000, 0b00000000, 0b00000000, 0b00000000,
  0b00000000, 0b00000000, 0b00000000, 0b00000000, 0b00000000, 0b00000000, 0b00000000, 0b00000000,
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  0b00000000, 0b00000000, 0b00000000, 0b00000000, 0b00000000, 0b00000000, 0b00000000, 0b00000000 };

static const unsigned char lose_screen[] PROGMEM = 
{ 0b00000000, 0b00000000, 0b00000000, 0b00000000, 0b00000000, 0b00000000, 0b00000000, 0b00000000,
  0b00000000, 0b00000000, 0b00000000, 0b00000000, 0b00000000, 0b00000000, 0b00000000, 0b00000000,
  0b00000000, 0b00000000, 0b00000000, 0b00000000, 0b00000000, 0b00000000, 0b00000000, 0b00000000,
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  0b00000000, 0b00000000, 0b00000000, 0b00000000, 0b00000000, 0b00000000, 0b00000000, 0b00000000 };



const unsigned char * const models[5] PROGMEM = {FUX55, ONA35, ANS17, FUX55, ONA35};
int8_t modelindex;

void setup() 
{
  Serial.begin(9600);
  delay(500);
  if(!display.begin(SSD1306_SWITCHCAPVCC, 0x3C)) 
  {
    Serial.println(F("SSD1306 allocation failed"));
    for(;;);
  }
  delay(500);

  for(int8_t i=0; i<30; i++)
  {
    goodpews[i][0] = -2;
    goodpews[i][1] = -2;
    evilpews[i][0] = 128;
    evilpews[i][1] = 128;
  }

  display.setTextColor(1);
  
  display.clearDisplay();
  display.setRotation(3);
  display.display();
  display.invertDisplay(true);
  chooseskin();
  display.drawBitmap(BOSS_X, BOSS_Y, MOLE9, 32, 32, 1);
  drawstarship(STARSHIP_X, 1);
  countdown();
  
  fight();


}

void loop() 
{
}


void fight()
{
  bool bossturn = 0;

  while (true)
  {
    fightreadkeys();

    if (BOSS_HEALTH <= 0) youwin(); 
    else if (STARSHIP_HEALTH <= 0) youlose();

    if (bossturn == 1) {advancephase(); bossturn = 0;}
    else bossturn = 1;

    display.clearDisplay();
    display.drawBitmap(BOSS_X, BOSS_Y, MOLE9, 32, 32, 1);
    drawstarship(STARSHIP_X, 1);
    drawallpews();
    display.display();
  }
}

void advancephase()
{
  if (bossphase == 0) 
  {
    bossphase = random(1, 4);
    if (bossphase == 1) {bossrand = random(2, 5); leftright = random(0, 2);}// Serial.println(leftright);}
  }

  else if (bossphase == 1) bossphase1();                         //move like idiot



  else if (bossphase == 2)                                       //pew and teleport UPGRADE NUMBER OF IFS
  {
    if (phasestage < 2) phasestage++;
    else if (phasestage < 4)  {BOSS_X = 65; phasestage++;}
    else if (phasestage < 6)  {BOSS_X = 16; phasestage++;}
    else if (phasestage < 8)  {BOSS_X = 65; phasestage++;}
    else if (phasestage < 14) {BOSS_X = 0;  phasestage++;}
    else if (phasestage < 16) {BOSS_X = 65; phasestage++;}
    else if (phasestage < 22) {BOSS_X = 31; phasestage++;}
    else if (phasestage < 24) {BOSS_X = 65;  phasestage++;}
    else if (phasestage < 30) {BOSS_X = 16;  phasestage++;}

  }
  else if (bossphase == 3) bossphase = 2;                         //LASER!!!!
}

void bossphase1()
{
  if (phasestage <= bossrand)
  {
    if      ((leftright == 0) and (BOSS_X >= 4))   BOSS_X -= 4;
    else if ((leftright == 1) and (BOSS_X <= 27))  BOSS_X += 4;
    else if  (leftright == 1)                     {BOSS_X -= 4; leftright = 0;}
    else                                          {BOSS_X += 4; leftright = 1;}
    phasestage ++;
  }
  else {bossphase = 0; phasestage = 0;}
}

void drawallpews()
{
  for(int8_t i=0; i<30; i++)
  {
    if (goodpews[i][1] < 128)
    {
      drawpewandhit(evilpews[i][0], evilpews[i][1], i, 0, 0);
      evilpews[i][1] += 2;
      drawpewandhit(evilpews[i][0], evilpews[i][1], i, 1, 0);
    }

    if (goodpews[i][1] > -2)
    {
      drawpewandhit(goodpews[i][0], goodpews[i][1], i, 0, 1);
      goodpews[i][1] -= 2;
      drawpewandhit(goodpews[i][0], goodpews[i][1], i, 1, 1);
    }
  }

}

void fightreadkeys()
{
  int16_t wait = 0;
  int8_t pewiter = 0;

  while (true)
  {
    char key2 = keypad.getKey();

    if ((key2 == '7') && (STARSHIP_X > 1))    //move left
    {
      STARSHIP_X -= 2;
      break;
    }

    if ((key2 == '9') && (STARSHIP_X < 48))   //moveright
    {
      STARSHIP_X += 2;
      break;
    }

    if (key2 == '8')                          //shoot
    {
      while (pewiter < 30)
      {
        if (goodpews[pewiter][1] <= -2)
        {
          goodpews[pewiter][0] = STARSHIP_X + 7;
          goodpews[pewiter][1] = STARSHIP_Y + 2;
          break;
        }
        pewiter++;
      }
      break;
    }


    
    if (wait > 3000)                          //if no input from user
    {
      break;
    }
    wait++;
  }
  
}

void drawpewandhit(int8_t x, int8_t y, int8_t i, bool colour, bool goodevil)
{
  if (colour == 0)
  {
    display.drawPixel(x, y, 0);
    display.drawPixel(x+1, y, 0);
    display.drawPixel(x, y-1, 0);
    display.drawPixel(x+1, y-1, 0);
  }

  else
  {
    if ((goodevil == 0) and ((y < 128) and (y + 1 > STARSHIP_Y) and (x+1 >= STARSHIP_X) and (x <= STARSHIP_X + 15)))
    {
      STARSHIP_HEALTH--;
      evilpews[i][0] = 150;
      evilpews[i][1] = 150;
    }

    else if ((y >= -1) and (y < 32) and (x+1 >= BOSS_X) and (x <= BOSS_X + 31))     // and (goodevil == 1) 
    {
      BOSS_HEALTH--;
      goodpews[i][0] = -5;
      goodpews[i][1] = -5;
    }

    else
    {
      display.drawPixel(x, y, 1);
      display.drawPixel(x+1, y, 1);
      display.drawPixel(x, y-1, 1);
      display.drawPixel(x+1, y-1, 1);
    }
  }
  
}

void drawstarship(int8_t x, bool colour)
{
  if      (modelindex == 0)   display.drawBitmap(x, STARSHIP_Y, models[0], 16, 16, colour);
  else if (modelindex == 1)   display.drawBitmap(x, STARSHIP_Y, models[1], 16, 16, colour);
  else if (modelindex == 2)   display.drawBitmap(x, STARSHIP_Y, models[2], 16, 16, colour);
  else if (modelindex == 3)   display.drawBitmap(x, STARSHIP_Y, models[3], 16, 16, colour);
  else                        display.drawBitmap(x, STARSHIP_Y, models[4], 16, 16, colour);
}

void countdown()
{
  display.setTextSize(3); 
  for (int8_t i = 3; i>0; i--)
  {
    display.setTextColor(1);
    display.setCursor(25, 57);
    display.println(i);
    display.display();
    delay(900);
    display.setTextColor(0);
    display.setCursor(25, 57);
    display.println(i);
    display.display();
    delay(100);
  }
}

void chooseskin()
{
  int8_t curroption = 0;
  display.setTextSize(1); 
  drawskins(curroption);
  while (true)
  {
    char key = keypad.getKey();
    if (key == 'A')
    {
      display.invertDisplay(false);
      display.clearDisplay();
      display.drawLine(0, 64 + 10, 64, 64 + 10, 1);
      display.drawLine(0, 64 - 11, 64, 64 - 11, 1);
      if (curroption == 0)
      {
        modelindex = 2; 
        display.drawBitmap(24, 57, models[2], STARSHIP_LEN, STARSHIP_LEN, 1);
      }
      else if (curroption == -1 or curroption == 2)
      {
        modelindex = 0; 
        display.drawBitmap(24, 57, models[0], STARSHIP_LEN, STARSHIP_LEN, 1);
      }
      else
      {
        modelindex = 1;
        display.drawBitmap(24, 57, models[1], STARSHIP_LEN, STARSHIP_LEN, 1);
      }
      delay(200);
      display.display();
      delay(2500);
      display.clearDisplay();
      display.display();
      break;
    }
    else if (key == '2')
    {
      curroption = curroption + (curroption < 2);
      drawskins(curroption);
    } 
    else if (key == '8')
    {
      curroption = curroption - (curroption > -2);
      drawskins(curroption);
    } 
  }
  delay(1000);
}

void drawskins(int8_t curroption)
{
  const byte CONST_SKIN_HEIGHT = 57 + curroption * 25;
  display.clearDisplay();
  display.drawLine(0, (display.height() / 2) + 10, display.width(), (display.height() / 2) + 10, 1);
  display.drawLine(0, (display.height() / 2) - 11, display.width(), (display.height() / 2) - 11, 1);

  display.drawBitmap(5, CONST_SKIN_HEIGHT - 50, models[0], STARSHIP_LEN, STARSHIP_LEN, 1);
  display.setCursor(29, CONST_SKIN_HEIGHT + 4 - 50);
  display.println("FUX55");
  display.drawPixel(63, 127, 1);
  display.display();
  display.drawBitmap(5, CONST_SKIN_HEIGHT - 25, models[1], STARSHIP_LEN, STARSHIP_LEN, 1);
  display.setCursor(29, CONST_SKIN_HEIGHT + 4 - 25);
  display.println("ONA35");
  display.display();
  display.drawBitmap(5, CONST_SKIN_HEIGHT,     models[2], STARSHIP_LEN, STARSHIP_LEN, 1);
  display.setCursor(29, CONST_SKIN_HEIGHT + 4);
  display.println("ANS17");
  display.display();
  display.drawBitmap(5, CONST_SKIN_HEIGHT + 25, models[3], STARSHIP_LEN, STARSHIP_LEN, 1);
  display.setCursor(29, CONST_SKIN_HEIGHT + 4 + 25);
  display.println("FUX55");
  display.display();
  display.drawBitmap(5, CONST_SKIN_HEIGHT + 50, models[4], STARSHIP_LEN, STARSHIP_LEN, 1);
  display.setCursor(29, CONST_SKIN_HEIGHT + 4 + 50);
  display.println("ONA35");
  display.display();

  //for(int8_t i==-2; i<5; i++) {              This stupid thing doesn't seem to work in a loop, I can't do it with a loop
    //display.drawBitmap((display.width() - STARSHIP_LEN) / 2, (display.height()  - STARSHIP_LEN) / 2 + 1 + i * 25 + curroption * 25, models[i+2], STARSHIP_LEN, STARSHIP_LEN, 1);
    //display.display();}

}

void youlose() 
{
  display.clearDisplay();
  display.drawBitmap(1, 1, lose_screen, 64, 128, 1);
  display.display();
  while (true)
  {
    delay(1000);
    display.invertDisplay(true);
    delay(1000);
    display.invertDisplay(false);
  }
}

void youwin() 
{
  display.clearDisplay();
  display.drawBitmap(1, 1, win_screen, 64, 128, 1);
  display.display();
  while (true)
  {
    delay(1000);
    display.invertDisplay(true);
    delay(1000);
    display.invertDisplay(false);
  }
}